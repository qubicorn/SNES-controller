## src/Kconfig.projbuild
```kconfig
menu "Project config"

    config ESP_WIFI_SSID
        string "WiFi SSID"
        default "myssid"
        help
            SSID of access point to connect to
    config ESP_WIFI_PASSWORD
        string "WiFi Password"
        default "mypassword"
        help
            WiFi password
    config ESP_WIFI_MAX_RETRY
        int "Maximum retry"
        default 5
        help
            Set the Maximum retry to avoid station reconnecting to the AP unlimited when the AP is really inexistent.

    config SNES_POLLILNG_RATE
        int "SNES controller polling rate in microseconds (min. 50us)"
        default "500"
    config SNES_LATCH_PULSE_WIDTH
        int "SNES latch low after microseconds (min. 20us)"
        default "20"
    config SNES_LATCH
        int "GPIO Output for SNES latch"
        default "18"
    config SNES_CLOCK
        int "GPIO Output for SNES clock"
        default "9"
    config SNES_DATA
        int "GPIO Input for SNES data"
        default "17"

    config HTTP_BACKEND_HOST
        string "HTTP Backend Host"
        default "10.0.0.50"
        help
            Host of backend server
    config HTTP_BACKEND_PORT
        int "HTTP Backend PORT"
        default 8032
        help
            Port of backend server

endmenu
```
